## build/Kconfig/Kconfig.sysbuild.modules
```kconfig
ZEPHYR_ACPICA_MODULE_DIR := C:/Work/zephyrproject/modules/lib/acpica
config ZEPHYR_ACPICA_MODULE
   bool
   default y
ZEPHYR_CMSIS_MODULE_DIR := C:/Work/zephyrproject/modules/hal/cmsis
config ZEPHYR_CMSIS_MODULE
   bool
   default y
ZEPHYR_CMSIS_DSP_MODULE_DIR := C:/Work/zephyrproject/modules/lib/cmsis-dsp
config ZEPHYR_CMSIS_DSP_MODULE
   bool
   default y
ZEPHYR_CMSIS_NN_MODULE_DIR := C:/Work/zephyrproject/modules/lib/cmsis-nn
config ZEPHYR_CMSIS_NN_MODULE
   bool
   default y
ZEPHYR_CMSIS_6_MODULE_DIR := C:/Work/zephyrproject/modules/hal/cmsis_6
config ZEPHYR_CMSIS_6_MODULE
   bool
   default y
ZEPHYR_FATFS_MODULE_DIR := C:/Work/zephyrproject/modules/fs/fatfs
config ZEPHYR_FATFS_MODULE
   bool
   default y
ZEPHYR_ADI_MODULE_DIR := C:/Work/zephyrproject/modules/hal/adi
config ZEPHYR_ADI_MODULE
   bool
   default y
ZEPHYR_HAL_AFBR_MODULE_DIR := C:/Work/zephyrproject/modules/hal/afbr
config ZEPHYR_HAL_AFBR_MODULE
   bool
   default y
ZEPHYR_HAL_AMBIQ_MODULE_DIR := C:/Work/zephyrproject/modules/hal/ambiq
config ZEPHYR_HAL_AMBIQ_MODULE
   bool
   default y
ZEPHYR_ATMEL_MODULE_DIR := C:/Work/zephyrproject/modules/hal/atmel
config ZEPHYR_ATMEL_MODULE
   bool
   default y
ZEPHYR_HAL_BOUFFALOLAB_MODULE_DIR := C:/Work/zephyrproject/modules/hal/bouffalolab
config ZEPHYR_HAL_BOUFFALOLAB_MODULE
   bool
   default y
ZEPHYR_HAL_ESPRESSIF_MODULE_DIR := C:/Work/zephyrproject/modules/hal/espressif
config ZEPHYR_HAL_ESPRESSIF_MODULE
   bool
   default y
ZEPHYR_HAL_ETHOS_U_MODULE_DIR := C:/Work/zephyrproject/modules/hal/ethos_u
config ZEPHYR_HAL_ETHOS_U_MODULE
   bool
   default y
ZEPHYR_HAL_GIGADEVICE_MODULE_DIR := C:/Work/zephyrproject/modules/hal/gigadevice
config ZEPHYR_HAL_GIGADEVICE_MODULE
   bool
   default y
ZEPHYR_HAL_INFINEON_MODULE_DIR := C:/Work/zephyrproject/modules/hal/infineon
config ZEPHYR_HAL_INFINEON_MODULE
   bool
   default y
ZEPHYR_HAL_INTEL_MODULE_DIR := C:/Work/zephyrproject/modules/hal/intel
config ZEPHYR_HAL_INTEL_MODULE
   bool
   default y
ZEPHYR_MICROCHIP_MODULE_DIR := C:/Work/zephyrproject/modules/hal/microchip
config ZEPHYR_MICROCHIP_MODULE
   bool
   default y
ZEPHYR_HAL_NORDIC_MODULE_DIR := C:/Work/zephyrproject/modules/hal/nordic
config ZEPHYR_HAL_NORDIC_MODULE
   bool
   default y
ZEPHYR_NUVOTON_MODULE_DIR := C:/Work/zephyrproject/modules/hal/nuvoton
config ZEPHYR_NUVOTON_MODULE
   bool
   default y
ZEPHYR_HAL_NXP_MODULE_DIR := C:/Work/zephyrproject/modules/hal/nxp
config ZEPHYR_HAL_NXP_MODULE
   bool
   default y
ZEPHYR_OPENISA_MODULE_DIR := C:/Work/zephyrproject/modules/hal/openisa
config ZEPHYR_OPENISA_MODULE
   bool
   default y
ZEPHYR_QUICKLOGIC_MODULE_DIR := C:/Work/zephyrproject/modules/hal/quicklogic
config ZEPHYR_QUICKLOGIC_MODULE
   bool
   default y
ZEPHYR_HAL_RENESAS_MODULE_DIR := C:/Work/zephyrproject/modules/hal/renesas
config ZEPHYR_HAL_RENESAS_MODULE
   bool
   default y
ZEPHYR_HAL_RPI_PICO_MODULE_DIR := C:/Work/zephyrproject/modules/hal/rpi_pico
config ZEPHYR_HAL_RPI_PICO_MODULE
   bool
   default y
ZEPHYR_HAL_SILABS_MODULE_DIR := C:/Work/zephyrproject/modules/hal/silabs
config ZEPHYR_HAL_SILABS_MODULE
   bool
   default y
ZEPHYR_HAL_ST_MODULE_DIR := C:/Work/zephyrproject/modules/hal/st
config ZEPHYR_HAL_ST_MODULE
   bool
   default y
ZEPHYR_HAL_STM32_MODULE_DIR := C:/Work/zephyrproject/modules/hal/stm32
config ZEPHYR_HAL_STM32_MODULE
   bool
   default y
ZEPHYR_HAL_TDK_MODULE_DIR := C:/Work/zephyrproject/modules/hal/tdk
config ZEPHYR_HAL_TDK_MODULE
   bool
   default y
ZEPHYR_HAL_TELINK_MODULE_DIR := C:/Work/zephyrproject/modules/hal/telink
config ZEPHYR_HAL_TELINK_MODULE
   bool
   default y
ZEPHYR_TI_MODULE_DIR := C:/Work/zephyrproject/modules/hal/ti
config ZEPHYR_TI_MODULE
   bool
   default y
ZEPHYR_HAL_WCH_MODULE_DIR := C:/Work/zephyrproject/modules/hal/wch
config ZEPHYR_HAL_WCH_MODULE
   bool
   default y
ZEPHYR_HAL_WURTHELEKTRONIK_MODULE_DIR := C:/Work/zephyrproject/modules/hal/wurthelektronik
config ZEPHYR_HAL_WURTHELEKTRONIK_MODULE
   bool
   default y
ZEPHYR_XTENSA_MODULE_DIR := C:/Work/zephyrproject/modules/hal/xtensa
config ZEPHYR_XTENSA_MODULE
   bool
   default y
ZEPHYR_HOSTAP_MODULE_DIR := C:/Work/zephyrproject/modules/lib/hostap
config ZEPHYR_HOSTAP_MODULE
   bool
   default y
ZEPHYR_LIBLC3_MODULE_DIR := C:/Work/zephyrproject/modules/lib/liblc3
config ZEPHYR_LIBLC3_MODULE
   bool
   default y
ZEPHYR_LIBMCTP_MODULE_DIR := C:/Work/zephyrproject/modules/lib/libmctp
config ZEPHYR_LIBMCTP_MODULE
   bool
   default y
ZEPHYR_LIBMETAL_MODULE_DIR := C:/Work/zephyrproject/modules/hal/libmetal
config ZEPHYR_LIBMETAL_MODULE
   bool
   default y
ZEPHYR_LIBSBC_MODULE_DIR := C:/Work/zephyrproject/modules/lib/libsbc
config ZEPHYR_LIBSBC_MODULE
   bool
   default y
ZEPHYR_LITTLEFS_MODULE_DIR := C:/Work/zephyrproject/modules/fs/littlefs
config ZEPHYR_LITTLEFS_MODULE
   bool
   default y
ZEPHYR_LORAMAC_NODE_MODULE_DIR := C:/Work/zephyrproject/modules/lib/loramac-node
config ZEPHYR_LORAMAC_NODE_MODULE
   bool
   default y
ZEPHYR_LVGL_MODULE_DIR := C:/Work/zephyrproject/modules/lib/gui/lvgl
config ZEPHYR_LVGL_MODULE
   bool
   default y
ZEPHYR_MBEDTLS_MODULE_DIR := C:/Work/zephyrproject/modules/crypto/mbedtls
config ZEPHYR_MBEDTLS_MODULE
   bool
   default y
ZEPHYR_MCUBOOT_MODULE_DIR := C:/Work/zephyrproject/bootloader/mcuboot
config ZEPHYR_MCUBOOT_MODULE
   bool
   default y
ZEPHYR_MIPI_SYS_T_MODULE_DIR := C:/Work/zephyrproject/modules/debug/mipi-sys-t
config ZEPHYR_MIPI_SYS_T_MODULE
   bool
   default y
ZEPHYR_NANOPB_MODULE_DIR := C:/Work/zephyrproject/modules/lib/nanopb
config ZEPHYR_NANOPB_MODULE
   bool
   default y
ZEPHYR_NRF_WIFI_MODULE_DIR := C:/Work/zephyrproject/modules/lib/nrf_wifi
config ZEPHYR_NRF_WIFI_MODULE
   bool
   default y
ZEPHYR_OPEN_AMP_MODULE_DIR := C:/Work/zephyrproject/modules/lib/open-amp
config ZEPHYR_OPEN_AMP_MODULE
   bool
   default y
ZEPHYR_OPENTHREAD_MODULE_DIR := C:/Work/zephyrproject/modules/lib/openthread
config ZEPHYR_OPENTHREAD_MODULE
   bool
   default y
ZEPHYR_PERCEPIO_MODULE_DIR := C:/Work/zephyrproject/modules/debug/percepio
config ZEPHYR_PERCEPIO_MODULE
   bool
   default y
ZEPHYR_PICOLIBC_MODULE_DIR := C:/Work/zephyrproject/modules/lib/picolibc
config ZEPHYR_PICOLIBC_MODULE
   bool
   default y
ZEPHYR_SEGGER_MODULE_DIR := C:/Work/zephyrproject/modules/debug/segger
config ZEPHYR_SEGGER_MODULE
   bool
   default y
ZEPHYR_TRUSTED_FIRMWARE_A_MODULE_DIR := C:/Work/zephyrproject/modules/tee/tf-a/trusted-firmware-a
config ZEPHYR_TRUSTED_FIRMWARE_A_MODULE
   bool
   default y
ZEPHYR_TRUSTED_FIRMWARE_M_MODULE_DIR := C:/Work/zephyrproject/modules/tee/tf-m/trusted-firmware-m
config ZEPHYR_TRUSTED_FIRMWARE_M_MODULE
   bool
   default y
ZEPHYR_UOSCORE_UEDHOC_MODULE_DIR := C:/Work/zephyrproject/modules/lib/uoscore-uedhoc
config ZEPHYR_UOSCORE_UEDHOC_MODULE
   bool
   default y
ZEPHYR_ZCBOR_MODULE_DIR := C:/Work/zephyrproject/modules/lib/zcbor
config ZEPHYR_ZCBOR_MODULE
   bool
   default y
ZEPHYR_NRF_HW_MODELS_MODULE_DIR := C:/Work/zephyrproject/modules/bsim_hw_models/nrf_hw_models
config ZEPHYR_NRF_HW_MODELS_MODULE
   bool
   default y
```

## build/Kconfig/arch/Kconfig
```kconfig
# Load Zephyr Arch Kconfig descriptions.
osource "C:/Work/zephyrproject/zephyr/arch/rx/Kconfig"
osource "C:/Work/zephyrproject/zephyr/arch/x86/Kconfig"
osource "C:/Work/zephyrproject/zephyr/arch/xtensa/Kconfig"
osource "C:/Work/zephyrproject/zephyr/arch/sparc/Kconfig"
osource "C:/Work/zephyrproject/zephyr/arch/riscv/Kconfig"
osource "C:/Work/zephyrproject/zephyr/arch/posix/Kconfig"
osource "C:/Work/zephyrproject/zephyr/arch/mips/Kconfig"
osource "C:/Work/zephyrproject/zephyr/arch/arm64/Kconfig"
osource "C:/Work/zephyrproject/zephyr/arch/arm/Kconfig"
osource "C:/Work/zephyrproject/zephyr/arch/arc/Kconfig"
```

## build/Kconfig/boards/Kconfig
```kconfig
# Load Zephyr board Kconfig descriptions.
osource "C:/Work/zephyrproject/zephyr/boards/st/stm32h747i_disco/Kconfig"
```

## build/Kconfig/boards/Kconfig.defconfig
```kconfig
# Load Zephyr board defconfig descriptions.
osource "C:/Work/zephyrproject/zephyr/boards/st/stm32h747i_disco/Kconfig.defconfig"
```

## build/Kconfig/boards/Kconfig.sysbuild
```kconfig
# Load Sysbuild board Kconfig descriptions.
osource "C:/Work/zephyrproject/zephyr/boards/st/stm32h747i_disco/Kconfig.sysbuild"
```

## build/Kconfig/soc/Kconfig
```kconfig
# Load Zephyr SoC Kconfig descriptions.
osource "C:/Work/zephyrproject/zephyr/soc/xlnx/zynqmp/Kconfig"
osource "C:/Work/zephyrproject/zephyr/soc/xlnx/zynq7000/Kconfig"
osource "C:/Work/zephyrproject/zephyr/soc/xlnx/versalnet/Kconfig"
osource "C:/Work/zephyrproject/zephyr/soc/xlnx/versal2/Kconfig"
osource "C:/Work/zephyrproject/zephyr/soc/xen/Kconfig"
osource "C:/Work/zephyrproject/zephyr/soc/wch/ch32v/Kconfig"
osource "C:/Work/zephyrproject/zephyr/soc/ti/simplelink/Kconfig"
osource "C:/Work/zephyrproject/zephyr/soc/ti/mspm0/Kconfig"
osource "C:/Work/zephyrproject/zephyr/soc/ti/lm3s6965/Kconfig"
osource "C:/Work/zephyrproject/zephyr/soc/ti/k3/Kconfig"
osource "C:/Work/zephyrproject/zephyr/soc/telink/tlsr/Kconfig"
osource "C:/Work/zephyrproject/zephyr/soc/starfive/jh71xx/Kconfig"
osource "C:/Work/zephyrproject/zephyr/soc/st/stm32/Kconfig"
osource "C:/Work/zephyrproject/zephyr/soc/snps/qemu_arc/Kconfig"
osource "C:/Work/zephyrproject/zephyr/soc/snps/nsim/arc_v/Kconfig"
osource "C:/Work/zephyrproject/zephyr/soc/snps/nsim/arc_classic/Kconfig"
osource "C:/Work/zephyrproject/zephyr/soc/snps/hsdk4xd/Kconfig"
osource "C:/Work/zephyrproject/zephyr/soc/snps/hsdk/Kconfig"
osource "C:/Work/zephyrproject/zephyr/soc/snps/emsk/Kconfig"
osource "C:/Work/zephyrproject/zephyr/soc/snps/emsdp/Kconfig"
osource "C:/Work/zephyrproject/zephyr/soc/snps/arc_iot/Kconfig"
osource "C:/Work/zephyrproject/zephyr/soc/silabs/Kconfig"
osource "C:/Work/zephyrproject/zephyr/soc/sifive/sifive_freedom/Kconfig"
osource "C:/Work/zephyrproject/zephyr/soc/sensry/Kconfig"
osource "C:/Work/zephyrproject/zephyr/soc/rockchip/Kconfig"
osource "C:/Work/zephyrproject/zephyr/soc/renode/riscv_virtual/Kconfig"
osource "C:/Work/zephyrproject/zephyr/soc/renode/cortex_r8_virtual/Kconfig"
osource "C:/Work/zephyrproject/zephyr/soc/renesas/smartbond/Kconfig"
osource "C:/Work/zephyrproject/zephyr/soc/renesas/rz/Kconfig"
osource "C:/Work/zephyrproject/zephyr/soc/renesas/rx/Kconfig"
osource "C:/Work/zephyrproject/zephyr/soc/renesas/rcar/Kconfig"
osource "C:/Work/zephyrproject/zephyr/soc/renesas/ra/Kconfig"
osource "C:/Work/zephyrproject/zephyr/soc/realtek/ec/Kconfig"
osource "C:/Work/zephyrproject/zephyr/soc/raspberrypi/rpi_pico/Kconfig"
osource "C:/Work/zephyrproject/zephyr/soc/quicklogic/eos_s3/Kconfig"
osource "C:/Work/zephyrproject/zephyr/soc/qemu/virt_riscv/Kconfig"
osource "C:/Work/zephyrproject/zephyr/soc/qemu/malta/Kconfig"
osource "C:/Work/zephyrproject/zephyr/soc/openisa/rv32m1/Kconfig"
osource "C:/Work/zephyrproject/zephyr/soc/openhwgroup/cva6/Kconfig"
osource "C:/Work/zephyrproject/zephyr/soc/oct/osd32mp15x/Kconfig"
osource "C:/Work/zephyrproject/zephyr/soc/nxp/s32/Kconfig"
osource "C:/Work/zephyrproject/zephyr/soc/nxp/rw/Kconfig"
osource "C:/Work/zephyrproject/zephyr/soc/nxp/mcx/Kconfig"
osource "C:/Work/zephyrproject/zephyr/soc/nxp/lpc/Kconfig"
osource "C:/Work/zephyrproject/zephyr/soc/nxp/layerscape/Kconfig"
osource "C:/Work/zephyrproject/zephyr/soc/nxp/kinetis/Kconfig"
osource "C:/Work/zephyrproject/zephyr/soc/nxp/imxrt/Kconfig"
osource "C:/Work/zephyrproject/zephyr/soc/nxp/imx/Kconfig"
osource "C:/Work/zephyrproject/zephyr/soc/nuvoton/numicro/Kconfig"
osource "C:/Work/zephyrproject/zephyr/soc/nuvoton/numaker/Kconfig"
osource "C:/Work/zephyrproject/zephyr/soc/nuvoton/npcx/Kconfig"
osource "C:/Work/zephyrproject/zephyr/soc/nuvoton/npcm/Kconfig"
osource "C:/Work/zephyrproject/zephyr/soc/nordic/Kconfig"
osource "C:/Work/zephyrproject/zephyr/soc/neorv32/Kconfig"
osource "C:/Work/zephyrproject/zephyr/soc/native/inf_clock/Kconfig"
osource "C:/Work/zephyrproject/zephyr/soc/microchip/sam/Kconfig"
osource "C:/Work/zephyrproject/zephyr/soc/microchip/sam/sam_d5x_e5x/Kconfig"
osource "C:/Work/zephyrproject/zephyr/soc/microchip/miv/Kconfig"
osource "C:/Work/zephyrproject/zephyr/soc/microchip/mec/Kconfig"
osource "C:/Work/zephyrproject/zephyr/soc/mediatek/mt8xxx/Kconfig"
osource "C:/Work/zephyrproject/zephyr/soc/lowrisc/opentitan/Kconfig"
osource "C:/Work/zephyrproject/zephyr/soc/litex/litex_vexriscv/Kconfig"
osource "C:/Work/zephyrproject/zephyr/soc/ite/ec/Kconfig"
osource "C:/Work/zephyrproject/zephyr/soc/intel/raptor_lake/Kconfig"
osource "C:/Work/zephyrproject/zephyr/soc/intel/panther_lake/Kconfig"
osource "C:/Work/zephyrproject/zephyr/soc/intel/lakemont/Kconfig"
osource "C:/Work/zephyrproject/zephyr/soc/intel/intel_socfpga_std/Kconfig"
osource "C:/Work/zephyrproject/zephyr/soc/intel/intel_socfpga/Kconfig"
osource "C:/Work/zephyrproject/zephyr/soc/intel/intel_niosv/Kconfig"
osource "C:/Work/zephyrproject/zephyr/soc/intel/intel_ish/Kconfig"
osource "C:/Work/zephyrproject/zephyr/soc/intel/intel_adsp/Kconfig"
osource "C:/Work/zephyrproject/zephyr/soc/intel/elkhart_lake/Kconfig"
osource "C:/Work/zephyrproject/zephyr/soc/intel/atom/Kconfig"
osource "C:/Work/zephyrproject/zephyr/soc/intel/apollo_lake/Kconfig"
osource "C:/Work/zephyrproject/zephyr/soc/intel/alder_lake/Kconfig"
osource "C:/Work/zephyrproject/zephyr/soc/infineon/cat3/Kconfig"
osource "C:/Work/zephyrproject/zephyr/soc/infineon/cat1c/Kconfig"
osource "C:/Work/zephyrproject/zephyr/soc/infineon/cat1b/Kconfig"
osource "C:/Work/zephyrproject/zephyr/soc/infineon/cat1a/Kconfig"
osource "C:/Work/zephyrproject/zephyr/soc/gd/gd32/Kconfig"
osource "C:/Work/zephyrproject/zephyr/soc/gaisler/leon3/Kconfig"
osource "C:/Work/zephyrproject/zephyr/soc/gaisler/gr716a/Kconfig"
osource "C:/Work/zephyrproject/zephyr/soc/espressif/Kconfig"
osource "C:/Work/zephyrproject/zephyr/soc/ene/kb1200/Kconfig"
osource "C:/Work/zephyrproject/zephyr/soc/ene/kb106x/Kconfig"
osource "C:/Work/zephyrproject/zephyr/soc/efinix/sapphire/Kconfig"
osource "C:/Work/zephyrproject/zephyr/soc/cdns/xtensa_sample_controller/Kconfig"
osource "C:/Work/zephyrproject/zephyr/soc/cdns/sample_controller32/Kconfig"
osource "C:/Work/zephyrproject/zephyr/soc/cdns/dc233c/Kconfig"
osource "C:/Work/zephyrproject/zephyr/soc/brcm/bcmvk/Kconfig"
osource "C:/Work/zephyrproject/zephyr/soc/brcm/bcm2712/Kconfig"
osource "C:/Work/zephyrproject/zephyr/soc/brcm/bcm2711/Kconfig"
osource "C:/Work/zephyrproject/zephyr/soc/bflb/Kconfig"
osource "C:/Work/zephyrproject/zephyr/soc/atmel/sam0/Kconfig"
osource "C:/Work/zephyrproject/zephyr/soc/atmel/sam/Kconfig"
osource "C:/Work/zephyrproject/zephyr/soc/aspeed/Kconfig"
osource "C:/Work/zephyrproject/zephyr/soc/arm/Kconfig"
osource "C:/Work/zephyrproject/zephyr/soc/arm/beetle/Kconfig"
osource "C:/Work/zephyrproject/zephyr/soc/antmicro/myra/Kconfig"
osource "C:/Work/zephyrproject/zephyr/soc/andestech/Kconfig"
osource "C:/Work/zephyrproject/zephyr/soc/amd/acp_6_0/Kconfig"
osource "C:/Work/zephyrproject/zephyr/soc/ambiq/Kconfig"
osource "C:/Work/zephyrproject/zephyr/soc/aesc/Kconfig"
osource "C:/Work/zephyrproject/zephyr/soc/adi/max32/Kconfig"
```
